## CMakeLists.txt
```
#
# Copyright (c) 2023 Nordic Semiconductor ASA
#
# SPDX-License-Identifier: LicenseRef-Nordic-5-Clause
#

cmake_minimum_required(VERSION 3.20.0)

find_package(Zephyr REQUIRED HINTS $ENV{ZEPHYR_BASE})
project(nRF9160CommsWithThingsboard)

target_sources(app PRIVATE src/main.c)
add_subdirectory(src/Mqtt_Comm)
add_subdirectory(src/Network_Manager)
add_subdirectory(src/LedHandler)
add_subdirectory(src/storage)

zephyr_include_directories(src)
```

## Kconfig
```
#
# Copyright (c) 2021 Nordic Semiconductor ASA
#
# SPDX-License-Identifier: LicenseRef-Nordic-5-Clause
#

menu "MQTT Comms with ThingsBoard"

	config MQTT_BROKER_HOSTNAME
		string "MQTT Broker Hostname"
		default "mqtt.thingsboard.cloud"
		help
			Hostname of the MQTT broker to connect to.

	config MQTT_CLIENT_ID
		string "MQTT Client ID"
		default "nRF9160CommsWithThingsBoard8567"
		help
			Client ID to use when connecting to the MQTT broker.
	config MQTT_USERNAME
		string "MQTT Username"
		default ""
		help
			Username to use when connecting to the MQTT broker.

	config MQTT_DEVICE_PROVISIONING_KEY
		string "Device Provisioning Key"
		default ""
		help
			Device provisioning key to use when connecting to the MQTT broker.
	
	config MQTT_DEVICE_PROVISIONING_SECRET
		string "Device Provisioning Secret"
		default ""
		help
			Device provisioning secret to use when connecting to the MQTT broker.

endmenu

menu "Zephyr Kernel"
source "Kconfig.zephyr"
endmenu
```

## prj.conf
```kconfig
# Network
CONFIG_NETWORKING=y
CONFIG_NET_SOCKETS=y
CONFIG_NET_SOCKETS_POSIX_NAMES=y
CONFIG_NET_NATIVE=n

CONFIG_HEAP_MEM_POOL_SIZE=10240
CONFIG_MAIN_STACK_SIZE=4096

# Modem Library
CONFIG_NRF_MODEM_LIB=y

# Modem Information 
CONFIG_MODEM_INFO=y

CONFIG_MODEM_KEY_MGMT=y

# LTE Link Control
CONFIG_LTE_LINK_CONTROL=y

# NEWLIB C Library
CONFIG_NEWLIB_LIBC=y

# Date-Time Library
CONFIG_DATE_TIME=y
# Enables use of modem time
CONFIG_DATE_TIME_MODEM=y
# Trigger date-time update automatically when LTE is connected
CONFIG_DATE_TIME_AUTO_UPDATE=y
# Date time update interval, in seconds (Default 14400/4 hours). 
# Set to 0 to disable date-time updates.
#CONFIG_DATE_TIME_UPDATE_INTERVAL_SECONDS=3600

# MQTT
CONFIG_MQTT_HELPER=y
CONFIG_MQTT_CLEAN_SESSION=y
# TLS
CONFIG_MQTT_LIB_TLS=y
CONFIG_MQTT_HELPER_PORT=8883
CONFIG_MQTT_KEEPALIVE=600

# Credentials located under <sample-dir>/src/modules/transport/credentials/ will be automatically
# provisioned to the nRF91 modem prior to connecting to the server.
CONFIG_MODEM_KEY_MGMT=y
CONFIG_MQTT_HELPER_SEC_TAG=955
CONFIG_MQTT_DEVICE_PROVISIONING_KEY="obvk0jffzweh332vf3a5"
CONFIG_MQTT_DEVICE_PROVISIONING_SECRET="0trne28dmb79s9hhjnbb"

CONFIG_PRINTK=y
CONFIG_LOG=y
CONFIG_LOG_BACKEND_UART=y

# Enable the LittleFS file system.
CONFIG_FILE_SYSTEM=y
CONFIG_FILE_SYSTEM_LITTLEFS=y

# SPI Flash
CONFIG_SPI=y
CONFIG_SPI_NOR=y
CONFIG_SPI_NOR_FLASH_LAYOUT_PAGE_SIZE=4096

# Enable flash operations.
CONFIG_FLASH=y
CONFIG_FLASH_MAP=y
CONFIG_FLASH_PAGE_LAYOUT=y

# Enable Zephyr application to be booted by MCUboot
CONFIG_BOOTLOADER_MCUBOOT=y

# Partition manager settings
CONFIG_PM_EXTERNAL_FLASH_MCUBOOT_SECONDARY=n
CONFIG_PM_PARTITION_REGION_LITTLEFS_EXTERNAL=y
CONFIG_PM_PARTITION_SIZE_LITTLEFS=0x1E000
CONFIG_PM_OVERRIDE_EXTERNAL_DRIVER_CHECK=y

# Enable CJSON library
CONFIG_CJSON_LIB=y
CONFIG_NEWLIB_LIBC=y
CONFIG_NEWLIB_LIBC_FLOAT_PRINTF=y

CONFIG_NRF_MODEM_LIB_TRACE=y
CONFIG_AT_HOST_LIBRARY=y #(note this is optional)

# PSM parameters
CONFIG_LTE_PSM_REQ=y
CONFIG_LTE_PSM_REQ_RPTAU="00101010" # TAU time of 10 minutes
CONFIG_LTE_PSM_REQ_RAT="00000101" # Active time of 10 seconds

# EDRX Parameters
# CONFIG_LTE_EDRX_REQ=y
```

## nrf9160dk_nrf9160_ns.overlay
```dts
/*
 * Copyright (c) 2019 Peter Bigot Consulting, LLC
 *
 * SPDX-License-Identifier: Apache-2.0
 */

//  /delete-node/ &storage_partition;

 /* Configure partition manager to use mx25r64 as the external flash device */
 / {
	 chosen {
		 nordic,pm-ext-flash = &mx25r64;
	 };
 };
```

## src/main.c
```c
/* Includes ----------------------------------------------------------- */
#include <zephyr/kernel.h>
#include <zephyr/sys/printk.h>
#include <nrf_modem_at.h>
#include "lte_network.h"
#include "mqtt_comm.h"
#include "LedHandler.h"
#include "SystemConfig.h"
#include "user_app.h"
#include "storage.h"
#include <stdio.h>
#include <stdlib.h>
#include <string.h>

/* Private defines ---------------------------------------------------- */
#define BOOT_COUNTER_FILE_NAME "bc"
/* Private enumerate/structure ---------------------------------------- */
/* Private macros ----------------------------------------------------- */
/* Public variables --------------------------------------------------- */
system_config_struct systemConfig;

/* Private variables -------------------------------------------------- */
static K_THREAD_STACK_DEFINE(user_app_thread_stack_area, 10240);
static struct k_thread user_app_thread_data;
k_tid_t user_app_tid;


/* Private function prototypes ---------------------------------------- */
static int32_t flashSelfTest(void);

/* Private function definitions ---------------------------------------- */
/**@brief           Function to perform flash self test.
 * 
 * param[in]        None.
 * 
 * @return          0 if successful, negative otherwise.
 * 
 */
static int32_t flashSelfTest(void)
{
	int32_t ret = 0;
	uint32_t bootCounter = 0;
	
	for (uint32_t i = 0; i < 3; i++)
	{
		ret = read_file(BOOT_COUNTER_FILE_NAME, (uint8_t*)&bootCounter, sizeof(bootCounter), DIRECTORY);
		bootCounter++;
		ret = write_file(BOOT_COUNTER_FILE_NAME, (uint8_t*)&bootCounter, sizeof(bootCounter), DIRECTORY);
		if(ret >= 0) break;
	}
	
	return ret;
}


/* Global Function definitions ----------------------------------------------- */
int main(void)
{
	int32_t ret = 0;
	uint8_t ATcommandResponseBuffer[128] = {0};

	printk("Starting application_OTA_Version\n");
	// EraseExternalFlash();
	// return 0;

	ret = flashSelfTest();
	if (ret < 0)
	{
		printk("Failed to initialize flash storage\n");
		return ret;
	}

	ret = mqtt_comm_init();
	if (ret != 0)
	{
		printk("Failed to initialize MQTT communication module\n");
		return ret;
	}

	ret = lte_network_init();
	if (ret != 0)
	{
		printk("Failed to initialize network module\n");
		return ret;
	}

	ret = LedInit();
	if (ret != 0)
	{
		printk("Failed to initialize LED module\n");
		return ret;
	}

	// Start the cellular thread it will manage all of its activity its own
	user_app_tid = k_thread_create(&user_app_thread_data, user_app_thread_stack_area,
							K_THREAD_STACK_SIZEOF(user_app_thread_stack_area),
							StartDataCommunication,
							NULL, NULL, NULL,
							K_HIGHEST_APPLICATION_THREAD_PRIO, K_ESSENTIAL, K_NO_WAIT);


	// Read the nRF9160 internal temperature every 5 seconds
	while (1)
	{
		ret = nrf_modem_at_cmd(ATcommandResponseBuffer, sizeof(ATcommandResponseBuffer), "AT%%XTEMP?");

		if (ret == 0)
		{
			sscanf(ATcommandResponseBuffer, "%%XTEMP: %d", &systemConfig.InternalTemp);
		}

		ret = nrf_modem_at_cmd(ATcommandResponseBuffer, sizeof(ATcommandResponseBuffer), "AT%%XMONITOR");
		if (ret == 0) printk("AT Response: %s\n", ATcommandResponseBuffer);

		// printf("Internal temperature: %d\n", systemConfig.InternalTemp);
		k_sleep(K_SECONDS(60));

	}
	

	return 0;

}
/* End of file -------------------------------------------------------- */
```

## src/SystemConfig.h
```c
/* Define to prevent recursive inclusion -------------------------------------*/
#ifndef __SYSTEMCONFIG_H
#define __SYSTEMCONFIG_H

#ifdef __cplusplus
extern "C"
{
#endif

/* Includes ------------------------------------------------------------------*/

/* Exported types ------------------------------------------------------------*/
typedef struct
{
    int InternalTemp;
    uint8_t isBrokerConnected;
    uint8_t ledState;
}system_config_struct;

/* Exported constants --------------------------------------------------------*/
/* Exported macro ------------------------------------------------------------*/

/*
******************************************************************************
* GLOBAL VARIABLES
******************************************************************************
*/
extern struct k_work_delayable mqtt_work;
extern system_config_struct systemConfig;

/*
******************************************************************************
* GLOBAL Functions
******************************************************************************
*/

#ifdef __cplusplus
}
#endif

#endif /* __SYSTEMCONFIG_H */
```
